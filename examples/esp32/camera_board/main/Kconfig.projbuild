## examples/esp32/camera_board/main/Kconfig.projbuild
```kconfig
menu "dc-device camera board"

config DC_DEVICE_WIFI_SSID
    string "Wi-Fi SSID (development only; ignored in a release build)"
    default ""

config DC_DEVICE_WIFI_PASSWORD
    string "Wi-Fi password"
    default ""

config DC_DEVICE_RELEASE
    bool "Release build"
    default n
    help
        Leaves out the debug.* capabilities and ignores the Wi-Fi name and
        password above. The network then comes only from USB setup.

config DC_DEVICE_HTTP_PORT
    int "HTTP port"
    default 8787
    range 1 65535

config DC_DEVICE_CAMERA_KNOWN_MAP
    bool "Start from the known camera wiring (SDA 4, SCL 5)"
    default y
    help
        Turn off to make the firmware find the camera by searching only,
        which is how the scan is tested.

endmenu
```

## examples/esp32/robot_car/main/Kconfig.projbuild
```kconfig
menu "dc-device robot car"

config DC_DEVICE_WIFI_SSID
    string "Wi-Fi SSID"
    default ""

config DC_DEVICE_WIFI_PASSWORD
    string "Wi-Fi password"
    default ""

config DC_DEVICE_HTTP_PORT
    int "HTTP port"
    default 8787
    range 1 65535

endmenu
```

## examples/esp32/robot_car/sdkconfig.defaults
```kconfig
CONFIG_IDF_TARGET_ESP32S3=y
CONFIG_HTTPD_MAX_REQ_HDR_LEN=1024
CONFIG_HTTPD_MAX_URI_LEN=512
CONFIG_ESPTOOLPY_FLASHSIZE_16MB=y
CONFIG_PARTITION_TABLE_SINGLE_APP_LARGE=y
CONFIG_ESP_MAIN_TASK_STACK_SIZE=8192
```
